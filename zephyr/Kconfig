## zephyr/Kconfig
```kconfig
config TINYCBOR_ORIGINAL
	bool "enable tinycbor-original module"
    default n
	help
	  Enable tinycbor-original module as a dependence in your project.

if TINYCBOR_ORIGINAL
endif # TINYCBOR_ORIGINAL
```
